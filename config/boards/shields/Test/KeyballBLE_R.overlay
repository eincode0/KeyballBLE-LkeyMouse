/* ===============================
 * KeyballBLE_R.overlay（全置き換え / 展開版：mm_* 分岐対応）
 *  - tb_wheel_rema : 常時スクロール端数繰り越し
 *  - tb_drop_all   : ジェスチャ中は REL_X/Y/WHEEL/HWHEEL を 0倍（完全停止）
 *  - 各レイヤーで mouse-gesture を切替
 *  - gesture の bindings は keymap 側の mm_l*_dir（Mod-Morph）へ委譲
 * =============================== */

#include "KeyballBLE.dtsi"

#include <input/processors.dtsi>
#include <mouse-gesture.dtsi>
#include <zephyr/dt-bindings/input/input-event-codes.h>
#include <dt-bindings/zmk/keys.h>
#include <dt-bindings/zmk/mouse.h>

&default_transform { col-offset = <6>; };

&kscan0 {
    col-gpios
        = <&xiao_d 10 GPIO_ACTIVE_HIGH>
        , <&xiao_d 9  GPIO_ACTIVE_HIGH>
        , <&xiao_d 8  GPIO_ACTIVE_HIGH>
        , <&xiao_d 7  GPIO_ACTIVE_HIGH>
        , <&gpio0 10  GPIO_ACTIVE_HIGH>
        ;
};

/ {
    /* ===============================
     * input processors
     * =============================== */
    input_processors {
        /* スクロール端数繰り越し（常時） */
        tb_wheel_rema: tb_wheel_rema {
            compatible = "zmk,input-processor-scaler";
            #input-processor-cells = <2>;
            type = <INPUT_EV_REL>;
            codes = <INPUT_REL_WHEEL>;
            track-remainders;
        };

        /* ★ジェスチャ中：カーソル＋スクロール完全停止（REL_* を 0倍） */
        tb_drop_all: tb_drop_all {
            compatible = "zmk,input-processor-scaler";
            #input-processor-cells = <2>;
            type = <INPUT_EV_REL>;
            codes = <INPUT_REL_X INPUT_REL_Y INPUT_REL_WHEEL INPUT_REL_HWHEEL>;
        };

        /* ===== A : アプリ操作 (layer 1) ===== */
        zip_mouse_gesture_l1: zip_mouse_gesture_l1 {
            compatible = "zmk,input-processor-mouse-gesture";
            #input-processor-cells = <0>;

            stroke-size = <70>;
            movement-threshold = <8>;
            idle-timeout-ms = <120>;
            gesture-cooldown-ms = <220>;
            enable-eager-mode;

            up    { pattern = <GESTURE_UP>;    bindings = <&mm_l1_up>;    };
            down  { pattern = <GESTURE_DOWN>;  bindings = <&mm_l1_down>;  };
            left  { pattern = <GESTURE_LEFT>;  bindings = <&mm_l1_left>;  };
            right { pattern = <GESTURE_RIGHT>; bindings = <&mm_l1_right>; };
        };

        /* ===== D : デスクトップ (layer 2) ===== */
        zip_mouse_gesture_l2: zip_mouse_gesture_l2 {
            compatible = "zmk,input-processor-mouse-gesture";
            #input-processor-cells = <0>;

            stroke-size = <70>;
            movement-threshold = <8>;
            idle-timeout-ms = <120>;
            gesture-cooldown-ms = <220>;
            enable-eager-mode;

            up    { pattern = <GESTURE_UP>;    bindings = <&mm_l2_up>;    };
            down  { pattern = <GESTURE_DOWN>;  bindings = <&mm_l2_down>;  };
            left  { pattern = <GESTURE_LEFT>;  bindings = <&mm_l2_left>;  };
            right { pattern = <GESTURE_RIGHT>; bindings = <&mm_l2_right>; };
        };

        /* ===== W : ウィンドウ (layer 3) ===== */
        zip_mouse_gesture_l3: zip_mouse_gesture_l3 {
            compatible = "zmk,input-processor-mouse-gesture";
            #input-processor-cells = <0>;

            stroke-size = <70>;
            movement-threshold = <8>;
            idle-timeout-ms = <120>;
            gesture-cooldown-ms = <220>;
            enable-eager-mode;

            up    { pattern = <GESTURE_UP>;    bindings = <&mm_l3_up>;    };
            down  { pattern = <GESTURE_DOWN>;  bindings = <&mm_l3_down>;  };
            left  { pattern = <GESTURE_LEFT>;  bindings = <&mm_l3_left>;  };
            right { pattern = <GESTURE_RIGHT>; bindings = <&mm_l3_right>; };
        };

        /* ===== T : タブ操作 (layer 7) ===== */
        zip_mouse_gesture_l7: zip_mouse_gesture_l7 {
            compatible = "zmk,input-processor-mouse-gesture";
            #input-processor-cells = <0>;

            stroke-size = <70>;
            movement-threshold = <8>;
            idle-timeout-ms = <120>;
            gesture-cooldown-ms = <180>;
            enable-eager-mode;

            up    { pattern = <GESTURE_UP>;    bindings = <&mm_l7_up>;    };
            down  { pattern = <GESTURE_DOWN>;  bindings = <&mm_l7_down>;  };
            left  { pattern = <GESTURE_LEFT>;  bindings = <&mm_l7_left>;  };
            right { pattern = <GESTURE_RIGHT>; bindings = <&mm_l7_right>; };
        };

        /* ===== S : スクショ (layer 13) ===== */
        zip_mouse_gesture_l13: zip_mouse_gesture_l13 {
            compatible = "zmk,input-processor-mouse-gesture";
            #input-processor-cells = <0>;

            stroke-size = <70>;
            movement-threshold = <8>;
            idle-timeout-ms = <120>;
            gesture-cooldown-ms = <220>;
            enable-eager-mode;

            up    { pattern = <GESTURE_UP>;    bindings = <&mm_l13_up>;    };
            down  { pattern = <GESTURE_DOWN>;  bindings = <&mm_l13_down>;  };
            left  { pattern = <GESTURE_LEFT>;  bindings = <&mm_l13_left>;  };
            right { pattern = <GESTURE_RIGHT>; bindings = <&mm_l13_right>; };
        };

        /* ===== M : メディア (layer 14) ===== */
        zip_mouse_gesture_l14: zip_mouse_gesture_l14 {
            compatible = "zmk,input-processor-mouse-gesture";
            #input-processor-cells = <0>;

            stroke-size = <70>;
            movement-threshold = <8>;
            idle-timeout-ms = <120>;
            gesture-cooldown-ms = <220>;
            enable-eager-mode;

            up    { pattern = <GESTURE_UP>;    bindings = <&mm_l14_up>;    };
            down  { pattern = <GESTURE_DOWN>;  bindings = <&mm_l14_down>;  };
            left  { pattern = <GESTURE_LEFT>;  bindings = <&mm_l14_left>;  };
            right { pattern = <GESTURE_RIGHT>; bindings = <&mm_l14_right>; };
        };

        /* ===== E : Edit (layer 11) ===== */
        zip_mouse_gesture_l11: zip_mouse_gesture_l11 {
            compatible = "zmk,input-processor-mouse-gesture";
            #input-processor-cells = <0>;

            stroke-size = <70>;
            movement-threshold = <8>;
            idle-timeout-ms = <120>;
            gesture-cooldown-ms = <220>;
            enable-eager-mode;

            up    { pattern = <GESTURE_UP>;    bindings = <&mm_l11_up>;    };
            down  { pattern = <GESTURE_DOWN>;  bindings = <&mm_l11_down>;  };
            left  { pattern = <GESTURE_LEFT>;  bindings = <&mm_l11_left>;  };
            right { pattern = <GESTURE_RIGHT>; bindings = <&mm_l11_right>; };
        };

        /* ===== R : Range (layer 12) ===== */
        zip_mouse_gesture_l12: zip_mouse_gesture_l12 {
            compatible = "zmk,input-processor-mouse-gesture";
            #input-processor-cells = <0>;

            stroke-size = <70>;
            movement-threshold = <8>;
            idle-timeout-ms = <120>;
            gesture-cooldown-ms = <220>;
            enable-eager-mode;

            up    { pattern = <GESTURE_UP>;    bindings = <&mm_l12_up>;    };
            down  { pattern = <GESTURE_DOWN>;  bindings = <&mm_l12_down>;  };
            left  { pattern = <GESTURE_LEFT>;  bindings = <&mm_l12_left>;  };
            right { pattern = <GESTURE_RIGHT>; bindings = <&mm_l12_right>; };
        };
    };

    /* ===============================
     * trackball listener
     * =============================== */
    trackball_listener: trackball_listener {
        compatible = "zmk,input-listener";
        device = <&trackball>;

        /* デフォルト（常時）：端数繰り越しだけ */
        input-processors = <&tb_wheel_rema 1 1>;

        /*
         * 指定レイヤー時：
         *   gesture が先に REL_X/Y を見て判定
         *   その後 tb_drop_all が REL_* 出力を 0倍にして「完全停止」
         */
        gesture_l1  { layers = <12>; input-processors = <&zip_mouse_gesture_l1  &tb_drop_all 0 1>; };  /* A = GESTURE_A */
        gesture_l2  { layers = <13>; input-processors = <&zip_mouse_gesture_l2  &tb_drop_all 0 1>; };  /* D = GESTURE_D */
        gesture_l3  { layers = <14>; input-processors = <&zip_mouse_gesture_l3  &tb_drop_all 0 1>; };  /* W = GESTURE_W */
        gesture_l7  { layers = <11>; input-processors = <&zip_mouse_gesture_l7  &tb_drop_all 0 1>; };  /* T = GESTURE_T */
        gesture_l11 { layers = <7>;  input-processors = <&zip_mouse_gesture_l11 &tb_drop_all 0 1>; };  /* E = GESTURE_E */
        gesture_l12 { layers = <8>;  input-processors = <&zip_mouse_gesture_l12 &tb_drop_all 0 1>; };  /* R = GESTURE_R */
        gesture_l13 { layers = <9>;  input-processors = <&zip_mouse_gesture_l13 &tb_drop_all 0 1>; };  /* S = GESTURE_S */
        gesture_l14 { layers = <10>; input-processors = <&zip_mouse_gesture_l14 &tb_drop_all 0 1>; };  /* M = GESTURE_M */
    };

    /* 自動ON/OFF（入場でON / 退場でOFF） */
    layer_listeners {
        compatible = "zmk,layer-listeners";

        gesture_auto {
            gesture_auto { layers = <12 13 14 11 7 8 9 10>;
            bindings = <&mouse_gesture_on &mouse_gesture_off>;
        };
    };
};

/* ===============================
 * PMW3610 SPI
 * =============================== */
&pinctrl {
    spi0_default: spi0_default {
        group1 {
            psels = <NRF_PSEL(SPIM_SCK, 0, 5)
                     NRF_PSEL(SPIM_MOSI, 0, 4)
                     NRF_PSEL(SPIM_MISO, 0, 4)>;
        };
    };

    spi0_sleep: spi0_sleep {
        group1 {
            psels = <NRF_PSEL(SPIM_SCK, 0, 5)
                     NRF_PSEL(SPIM_MOSI, 0, 4)
                     NRF_PSEL(SPIM_MISO, 0, 4)>;
            low-power-enable;
        };
    };
};

&spi0 {
    status = "okay";
    compatible = "nordic,nrf-spim";
    pinctrl-0 = <&spi0_default>;
    pinctrl-1 = <&spi0_sleep>;
    pinctrl-names = "default", "sleep";
    cs-gpios = <&gpio0 9 GPIO_ACTIVE_LOW>;

    trackball: trackball@0 {
        status = "okay";
        compatible = "pixart,pmw3610";
        reg = <0>;
        spi-max-frequency = <2000000>;
        irq-gpios = <&gpio0 2 (GPIO_ACTIVE_LOW | GPIO_PULL_UP)>;
        scroll-layers = <5>;
    };
};
